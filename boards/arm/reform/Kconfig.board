## boards/arm/reform/Kconfig.board
```kconfig
config BOARD_REFORM
    bool "MNT Reform Keyboard 4.0"
    depends on SOC_RP2040
```

## boards/arm/reform/Kconfig.defconfig
```kconfig
if BOARD_REFORM

config ZMK_KEYBOARD_NAME
    default "MNT Reform KB"

config RP2_FLASH_W25Q080
    default y

endif # BOARD_REFORM
```

## boards/arm/reform/reform_defconfig
```kconfig
CONFIG_SOC_SERIES_RP2XXX=y
CONFIG_SOC_RP2040=y
CONFIG_BOARD_REFORM=y

CONFIG_SYS_CLOCK_HW_CYCLES_PER_SEC=125000000

# Enable reset by default
CONFIG_RESET=y

# Code partition needed to target the correct flash range
CONFIG_USE_DT_CODE_PARTITION=y

# Output UF2 by default, native bootloader supports it.
CONFIG_BUILD_OUTPUT_UF2=y

# Enable USB
CONFIG_ZMK_USB=y
CONFIG_USB_HID_POLL_INTERVAL_MS=5

CONFIG_ZMK_WPM=y

# Enable Display
CONFIG_ZMK_DISPLAY=n
CONFIG_ZMK_DISPLAY_BLANK_ON_IDLE=y
CONFIG_ZMK_DISPLAY_WORK_QUEUE_DEDICATED=y
CONFIG_ZMK_DISPLAY_DEDICATED_THREAD_STACK_SIZE=4096
CONFIG_ZMK_DISPLAY_STATUS_SCREEN_CUSTOM=n
CONFIG_ZMK_DISPLAY_STATUS_SCREEN_BUILT_IN=y
CONFIG_ZMK_WIDGET_WPM_STATUS=y
CONFIG_ZMK_WIDGET_LAYER_STATUS=n
CONFIG_ZMK_WIDGET_OUTPUT_STATUS=n


# Enable RGB
CONFIG_SPI=n # Use PIO
CONFIG_WS2812_STRIP=y
CONFIG_ZMK_RGB_UNDERGLOW=n
CONFIG_ZMK_RGB_UNDERGLOW_AUTO_OFF_IDLE=n
CONFIG_ZMK_RGB_UNDERGLOW_EXT_POWER=n
CONFIG_ZMK_RGB_UNDERGLOW_BRT_MAX=80
CONFIG_ZMK_RGB_UNDERGLOW_ON_START=y
CONFIG_ZMK_RGB_UNDERGLOW_EFF_START=0
CONFIG_ZMK_RGB_UNDERGLOW_HUE_START=78
CONFIG_ZMK_RGB_UNDERGLOW_SAT_START=50
CONFIG_ZMK_RGB_UNDERGLOW_BRT_START=30


# Turn on logging, and set ZMK logging to debug output
CONFIG_LOG=y
CONFIG_SERIAL=y
CONFIG_CONSOLE=y
CONFIG_UART_CONSOLE=y
CONFIG_UART_LINE_CTRL=y
CONFIG_UART_INTERRUPT_DRIVEN=y

#CONFIG_LOG_PROCESS_THREAD_STARTUP_DELAY_MS=8000
CONFIG_ZMK_USB_LOGGING=n
CONFIG_ZMK_LOG_LEVEL_DBG=y
CONFIG_LOG_BUFFER_SIZE=20000
CONFIG_I2C_LOG_LEVEL_DBG=y
CONFIG_SPI_LOG_LEVEL_DBG=y
CONFIG_DISPLAY_LOG_LEVEL_DBG=y
CONFIG_SENSOR_LOG_LEVEL_DBG=y
```

## boards/mnt/pocket_reform/Kconfig
```kconfig
# SPDX-License-Identifier: GPL-3.0-or-later
# Copyright 2026 joguSD

config BOARD_POCKET_REFORM
    select RP2_FLASH_W25Q080
```

## boards/mnt/pocket_reform/Kconfig.pocket_reform
```kconfig
# SPDX-License-Identifier: GPL-3.0-or-later
# Copyright 2026 joguSD

config BOARD_POCKET_REFORM
    select SOC_RP2040
```

## boards/mnt/pocket_reform/board.yml
```yaml
board:
  name: pocket_reform
  full_name: Pocket Reform
  vendor: mnt
  socs:
  - name: rp2040
```

## boards/mnt/pocket_reform/pocket_reform_defconfig
```kconfig
# SPDX-License-Identifier: GPL-3.0-or-later
# Copyright 2026 joguSD

CONFIG_USB_DEVICE_VID=0x1209
CONFIG_USB_DEVICE_PID=0x6d06
CONFIG_USB_DEVICE_MANUFACTURER="MNT"

CONFIG_SYS_CLOCK_HW_CYCLES_PER_SEC=125000000

# Enable clock control by default
CONFIG_CLOCK_CONTROL=y

# Enable reset by default
CONFIG_RESET=y

# Configure flash paritioning and allow writing to save settings
CONFIG_USE_DT_CODE_PARTITION=y
CONFIG_MPU_ALLOW_FLASH_WRITE=y
CONFIG_SETTINGS=y
CONFIG_NVS=y
CONFIG_SETTINGS_NVS=y
CONFIG_FLASH=y
CONFIG_FLASH_PAGE_LAYOUT=y
CONFIG_FLASH_MAP=y

# Output UF2 by default, native bootloader supports it.
CONFIG_BUILD_OUTPUT_UF2=y

# Enable USB
CONFIG_ZMK_USB=y
CONFIG_USB_HID_POLL_INTERVAL_MS=5

# Enable UART for sysctrl communication
CONFIG_SERIAL=y
CONFIG_UART_INTERRUPT_DRIVEN=y

# Enable float support in snprintf for battery display
CONFIG_CBPRINTF_FP_SUPPORT=y

# Enable Display
CONFIG_DISPLAY=y
CONFIG_ZMK_DISPLAY=n

# Enable Pointing
CONFIG_ZMK_POINTING=y

# Enable RGB
CONFIG_ZMK_RGB_UNDERGLOW=y
CONFIG_ZMK_RGB_UNDERGLOW_AUTO_OFF_IDLE=n
CONFIG_ZMK_RGB_UNDERGLOW_EXT_POWER=n
CONFIG_ZMK_RGB_UNDERGLOW_BRT_MAX=30
CONFIG_ZMK_RGB_UNDERGLOW_ON_START=n
CONFIG_ZMK_RGB_UNDERGLOW_EFF_START=3
CONFIG_ZMK_RGB_UNDERGLOW_HUE_START=78
CONFIG_ZMK_RGB_UNDERGLOW_SAT_START=50
CONFIG_ZMK_RGB_UNDERGLOW_BRT_START=15
```

## boards/mnt/reform/Kconfig.defconfig
```kconfig
# SPDX-License-Identifier: GPL-3.0-or-later
# Copyright 2025 joguSD

if BOARD_REFORM

config ZMK_KEYBOARD_NAME
    default "MNT Reform KB"

if I2C_DW

config I2C_DW_CLOCK_SPEED
    default 125

endif # I2C_DW

config USB_SELF_POWERED
    default n

config USB_MAX_POWER
    default 250

config USB_DEVICE_REMOTE_WAKEUP
    default y

endif # BOARD_REFORM
```

## boards/mnt/reform/Kconfig.reform
```kconfig
# SPDX-License-Identifier: GPL-3.0-or-later
# Copyright 2025 joguSD

config BOARD_REFORM
    select SOC_RP2040
```

## boards/mnt/reform/board.yml
```yaml
board:
  name: reform
  full_name: Reform
  vendor: mnt
  socs:
  - name: rp2040
```

## boards/mnt/reform/reform_defconfig
```kconfig
# SPDX-License-Identifier: GPL-3.0-or-later
# Copyright 2025 joguSD

CONFIG_USB_DEVICE_VID=0x1209
CONFIG_USB_DEVICE_PID=0x6d02
CONFIG_USB_DEVICE_MANUFACTURER="MNT Research"

CONFIG_SYS_CLOCK_HW_CYCLES_PER_SEC=125000000

# Enable clock control by default
CONFIG_CLOCK_CONTROL=y

# Enable reset by default
CONFIG_RESET=y

# Configure flash paritioning and allow writing to save settings
CONFIG_USE_DT_CODE_PARTITION=y
CONFIG_MPU_ALLOW_FLASH_WRITE=y
CONFIG_SETTINGS=y
CONFIG_NVS=y
CONFIG_SETTINGS_NVS=y
CONFIG_FLASH=y
CONFIG_FLASH_PAGE_LAYOUT=y
CONFIG_FLASH_MAP=y

# Output UF2 by default, native bootloader supports it.
CONFIG_BUILD_OUTPUT_UF2=y

# Enable USB
CONFIG_ZMK_USB=y
CONFIG_USB_HID_POLL_INTERVAL_MS=5

CONFIG_ZMK_WPM=y

# Enable Display
CONFIG_ZMK_DISPLAY=n
CONFIG_ZMK_DISPLAY_BLANK_ON_IDLE=y
#CONFIG_ZMK_DISPLAY_WORK_QUEUE_DEDICATED=y
#CONFIG_ZMK_DISPLAY_DEDICATED_THREAD_STACK_SIZE=4096
CONFIG_ZMK_DISPLAY_STATUS_SCREEN_CUSTOM=n
CONFIG_ZMK_DISPLAY_STATUS_SCREEN_BUILT_IN=y
CONFIG_ZMK_WIDGET_WPM_STATUS=y
CONFIG_ZMK_WIDGET_LAYER_STATUS=n
CONFIG_ZMK_WIDGET_OUTPUT_STATUS=n


# Enable RGB
CONFIG_ZMK_RGB_UNDERGLOW=y
CONFIG_ZMK_RGB_UNDERGLOW_AUTO_OFF_IDLE=n
CONFIG_ZMK_RGB_UNDERGLOW_EXT_POWER=n
CONFIG_ZMK_RGB_UNDERGLOW_BRT_MAX=30
CONFIG_ZMK_RGB_UNDERGLOW_ON_START=n
CONFIG_ZMK_RGB_UNDERGLOW_EFF_START=3
CONFIG_ZMK_RGB_UNDERGLOW_HUE_START=78
CONFIG_ZMK_RGB_UNDERGLOW_SAT_START=50
CONFIG_ZMK_RGB_UNDERGLOW_BRT_START=15


# Turn on logging, and set ZMK logging to debug output
# CONFIG_LOG=y
# CONFIG_SERIAL=y
# CONFIG_CONSOLE=y
# CONFIG_UART_CONSOLE=y
# CONFIG_UART_LINE_CTRL=y
# CONFIG_UART_INTERRUPT_DRIVEN=y
#
# CONFIG_ZMK_USB_LOGGING=n
# CONFIG_ZMK_LOGGING_MINIMAL=y
# CONFIG_ZMK_LOG_LEVEL_DBG=n
# CONFIG_LOG_BUFFER_SIZE=20000
# CONFIG_I2C_LOG_LEVEL_DBG=y
# CONFIG_SPI_LOG_LEVEL_DBG=n
# CONFIG_DISPLAY_LOG_LEVEL_DBG=y
# CONFIG_SENSOR_LOG_LEVEL_DBG=y
```

## config/west.yml
```yaml
manifest:
  remotes:
    - name: zmkfirmware
      url-base: https://github.com/zmkfirmware
    - name: joguSD
      url-base: https://github.com/joguSD
    - name: petejohanson
      url-base: https://github.com/petejohanson
  projects:
    - name: zmk
      remote: petejohanson
      revision: core/move-to-zephyr-4-1
      import: app/west.yml
    - name: zephyr
      remote: joguSD
      revision: v4.1.0+zmk-fixes
      clone-depth: 1
      import:
        name-blocklist:
          - ci-tools
          - hal_altera
          - hal_cypress
          - hal_infineon
          - hal_microchip
          - hal_nxp
          - hal_openisa
          - hal_silabs
          - hal_xtensa
          - hal_st
          - hal_ti
          - loramac-node
          - mcuboot
          - mcumgr
          - net-tools
          - openthread
          - edtt
          - trusted-firmware-m
  self:
    path: config
```

## dts/bindings/behaviors/zmk,behavior-menu.yaml
```yaml
# SPDX-License-Identifier: GPL-3.0-or-later
# Copyright 2026 joguSD
description: Menu Behavior

compatible: "zmk,behavior-menu"

include: zero_param.yaml

child-binding:
  description: "Menu Item Definition"
  properties:
    text:
      type: string
      required: true
    key:
      type: int
      required: true
    bindings:
      type: phandle-array
      required: true
```

## dts/bindings/behaviors/zmk,behavior-reform-sysctrl.yaml
```yaml
# SPDX-License-Identifier: GPL-3.0-or-later
# Copyright 2026 joguSD
description: MNT Reform System Control Behavior

compatible: "zmk,behavior-reform-sysctrl"

include: two_param.yaml
```
