## Kconfig
```kconfig
# SPDX-License-Identifier: GPL-3.0-or-later
# Copyright 2026 joguSD
module = MNT
module-str = mnt
source "subsys/logging/Kconfig.template.log_config"

config MNT_REFORM_MODE
    int "MNT Reform mode (0=standalone, 1=classic, 2=next, 3=pocket)"
    default 0
    range 0 3

config MNT_TRACKBALL
    bool "MNT Reform polling trackball driver"
    default y
    depends on DT_HAS_MNT_TRACKBALL_ENABLED
    select I2C

config ZMK_BEHAVIOR_MENU
    bool
    default y
    depends on DT_HAS_ZMK_BEHAVIOR_MENU_ENABLED

if ZMK_BEHAVIOR_MENU

config ZMK_BEHAVIOR_MENU_TODO
    bool
    help
      Placeholder for menu configuration, delete if not needed

endif #ZMK_BEHAVIOR_MENU

config IQS9150
    bool "IQS9150 trackpad driver"
    default y
    depends on DT_HAS_AZOTEQ_IQS9150_ENABLED
    select I2C

config ZMK_INPUT_PROCESSOR_INC_DEC
    bool "Inc/Dec input processor"
    default y
    depends on DT_HAS_ZMK_INPUT_PROCESSOR_INC_DEC_ENABLED

DT_CHOSEN_MNT_PTP := mnt,ptp

config MNT_PTP
    bool

config MNT_PTP_USB_HID
    bool "PTP USB HID interface"
    default y
    depends on $(dt_chosen_enabled,$(DT_CHOSEN_MNT_PTP))
    depends on USB_DEVICE_HID
    select MNT_PTP

config MNT_PTP_USB_RESET
    bool "Reset PTP host state when USB resets"
    default y
    depends on MNT_PTP_USB_HID
    depends on ZMK_USB

config MNT_PTP_LAYER_INHIBIT
    bool "Suppress PTP reporting while a ZMK layer claims the trackpad"
    default y
    depends on MNT_PTP
    depends on ZMK_POINTING

config MNT_PTP_USB_HID_INSTANCE
    int "USB HID instance index for the PTP interface"
    default 1
    depends on MNT_PTP_USB_HID

config MNT_PTP_USB_HID_INIT_PRIORITY
    int "PTP USB HID init priority"
    default 95
    depends on MNT_PTP_USB_HID

config RP2040_SLEEP
    bool "RP2040 sleep mode driver"
    default y
    depends on DT_HAS_RASPBERRYPI_RP2040_SLEEP_ENABLED
    depends on SOC_RP2040
```

## boards/mnt/reform_pocket/Kconfig
```kconfig
# SPDX-License-Identifier: GPL-3.0-or-later
# Copyright 2026 joguSD

config BOARD_REFORM_POCKET
    select RP2_FLASH_W25Q080
```

## boards/mnt/reform_pocket/board.yml
```yaml
board:
  name: reform_pocket
  full_name: Pocket Reform
  vendor: mnt
  socs:
  - name: rp2040
```

## dts/bindings/behaviors/zmk,behavior-usb-guard.yaml
```yaml
# SPDX-License-Identifier: GPL-3.0-or-later
# Copyright 2026 joguSD
description: |
  Invokes the bound behavior only while a USB host is connected, otherwise
  displays the configured message.

compatible: "zmk,behavior-usb-guard"

include: zero_param.yaml

properties:
  bindings:
    type: phandle-array
    required: true
  message:
    type: string
    description: Text to display when no USB host is connected
```

## dts/bindings/input/mnt,trackball.yaml
```yaml
# SPDX-License-Identifier: GPL-3.0-or-later
# Copyright 2026 joguSD

description: PAT9125EL trackball (polling, no motion interrupt)

compatible: "mnt,trackball"

include: i2c-device.yaml

properties:
  invert-x:
    type: boolean
    description: Invert X axis
  invert-y:
    type: boolean
    description: Invert Y axis
```
