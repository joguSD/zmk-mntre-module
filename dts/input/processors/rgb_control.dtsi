/*
  SPDX-License-Identifier: GPL-3.0-or-later
  Copyright 2026 joguSD
*/

#include <zephyr/dt-bindings/input/input-event-codes.h>

/ {
    /omit-if-no-ref/ zip_x_rgb: zip_x_rgb {
        compatible = "zmk,input-processor-rgb-control";
        #input-processor-cells = <1>;
        type = <INPUT_EV_REL>;
        codes = <INPUT_REL_X>;
    };

    /omit-if-no-ref/ zip_y_rgb: zip_y_rgb {
        compatible = "zmk,input-processor-rgb-control";
        #input-processor-cells = <1>;
        type = <INPUT_EV_REL>;
        codes = <INPUT_REL_Y>;
    };
};
